#include<reg52.h>
#include <intrins.h>  
#define uint unsigned int  
#define uchar unsigned char  
sbit DATA=P1^0;//dht11data端接单片机的P1^0口//  
#define data  P0             //数据口
sbit RS=P3^5;            //寄存器选择输入 
sbit RW=P3^6;            //液晶读/写控制
sbit  E=P3^4;            //液晶使能控制
sbit PSB=P3^7;            //串/并方式控制
uchar code dis1[] = {"有人:Y"};
uchar code dis2[] = {"无人:N"};
//延时子程序
void delay_ms(uint z)
{
 uint x,y;
 for(x=z;x>0;x--)
  for(y=614;y>0;y--);
}

//////////////以下是LCD12864驱动程序////////////////
	
/*******************************************************************/
/*                                                                 */
/*检查LCD忙状态                                                    */
/*lcd_busy为1时，忙，等待。lcd-busy为0时,闲，可写指令与数据。      */
/*                                                                 */
/*******************************************************************/
bit busy()
 {                      
    bit result;
    P0=0X00;              //关掉数码管的信号。阻止数码管受到P0口信号的影响
    RS=0;
    RW=1;
     E=1;
    delay_ms(1);
    result=(bit)(P0&0x80);
     E=0;
    return(result); 
 }
/*******************************************************************/
/*                                                                 */
/*写指令数据到LCD                                                  */
/*RS=L，RW=L，E=高脉冲，D0-D7=指令码。                             */
/*                                                                 */
/*******************************************************************/
void wcmd(uchar cmd)
{                       
    while(busy());
    RS=0;
    RW=0;
     E=0;
    _nop_();
    _nop_(); 
    P0=cmd;
 	delay_ms(1);
     E=1;
 	delay_ms(1);
     E=0;  
}
/*******************************************************************/
/*                                                                 */
/*写显示数据到LCD                                                  */
/*RS=H，RW=L，E=高脉冲，D0-D7=数据。                               */
/*                                                                 */
/*******************************************************************/
void wdat(uchar dat)
{                          
   while(busy());
    RS=1;
    RW=0;
     E=0;
    P0=dat;
     delay_ms(1);
     E=1;
    delay_ms(1);
     E=0; 
}
/*******************************************************************/
/*                                                                 */
/*  LCD初始化设定                                                  */
/*                                                                 */
/*******************************************************************/
void init()
{ 

    PSB=1;         //并口方式
    wcmd(0x34);      //扩充指令操作
     delay_ms(5);
    wcmd(0x30);      //基本指令操作
    delay_ms(5);
    wcmd(0x0C);      //显示开，关光标
    delay_ms(5);
    wcmd(0x01);      //清除LCD的显示内容
    delay_ms(5);
}
/*********************************************************/
/*                                                       */
/* 设定显示位置                                          */
/*                                                       */
/*********************************************************/
void pos(uchar X,uchar Y)
{                          
   uchar  pos;
   if (X==0)
     {X=0x80;}
   else if (X==1)
     {X=0x90;}
   else if (X==2)
     {X=0x88;}
   else if (X==3)
     {X=0x98;}
   pos=X+Y ;  
   wcmd(pos);     //显示地址
}
//////////////////以上是LCD12864驱动程序////////////////

void main()//主函数模块//   
{      
    uchar i=0;
	init();
    delay_ms(1500); 

    while(1)     
    {  
		pos(0,0);
		i=0; 
		if(DATA == 1)
		{
			 while(dis1[i] != '\0')
             {                         //显示字符
    	      wdat(dis1[i]);
              i++;
              }
		}
		else
		{	 
		     while(dis2[i] != '\0')
             {                         //显示字符
    	      wdat(dis2[i]);
              i++;
              }
		}

    }  
}